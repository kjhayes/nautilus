## src/alloc/Kconfig
```kconfig
config ALLOCS
  bool "Enable Allocators"
  default n
  depends on X86_64_HOST
  depends on ALLOW_UNINTEGRATED
  select ALLOC_BASE
  help
     Enable allocator abstractions
     
config DEBUG_ALLOCS
  bool "Debug allocators core"
  depends on ALLOCS
  default n
  help
     Turn on debugging prints for the allocator core

config ALLOC_BASE
  bool "Base allocator"
  depends on ALLOCS
  default y
  help
     This is the base allocator, just a wrapper on the system allocator

config DEBUG_ALLOC_BASE
  bool "Debug the base allocator"
  depends on ALLOC_BASE
  default n
  help
     Turn on debugging prints for the base allocator

config ALLOC_BUMP
  bool "Bump allocator"
  depends on ALLOCS
  default n
  help
     This allocator never deallocates, but allocates in constant time

config DEBUG_ALLOC_BUMP
  bool "Debug the bump allocator"
  depends on ALLOC_BUMP
  default n
  help
     Turn on debugging prints for the dumb allocator

config ALLOC_IMPLICIT
  bool "Implicit free list allocator"
  depends on ALLOCS
  default n
  help
     Implicit Free list implementation

config DEBUG_ALLOC_IMPLICIT
  bool "Debug the implicit free list allocator"
  depends on ALLOC_IMPLICIT
  default n
  help
     Turn on debugging prints for the cs213 allocator

config DEBUG_ALLOC_TEST
  bool "Debug allocator test"
  depends on ALLOC_TEST
  default n
  help
     Turn on debugging prints for the allocator test
```

## src/arch/arm64/Kconfig
```kconfig
config ARM64_KERNEL_LINK_ADDR
    hex "Kernel Load Address"
    default 0x0
    help
      Sets the base address which the kernel is linked to be loaded at

config ARM64_HAS_SECURE_MONITOR
    bool "ARM Has Secure Monitor"
    default n
    depends on ARCH_ARM64
    help
      Is there trusted firmware present at EL3? (e.g. should we use HVC or SMC calls?)
```

## src/arch/gem5/Kconfig
```kconfig
config GEM5_FORCE_APIC_TIMER_CALIBRATION
depends on GEM5
bool "Force APIC timer calibration"
help
   Skip detection of APIC bus frequency, and CPU cycles
   per tick and simply set them to desired values.  Note
   that Gem5 gets timers right, but given how slow it is,
   it can feel ridiculous in real-time, especially
   when used interactively.
   DO NOT SET THIS IF YOU WANT ACCURATE SIMULATED TIME

config GEM5_APIC_BUS_FREQ_HZ
depends on GEM5_FORCE_APIC_TIMER_CALIBRATION
default 10000
int "APIC bus frequency (HZ)"
    help
   Desired APIC bus frequency
   The smaller this number is, the more frequent timer interrupts will be.
   If it is too small, you'll be in an interrupt storm.

config GEM5_APIC_CYCLES_PER_US
 depends on GEM5_FORCE_APIC_TIMER_CALIBRATION
 default 10
 int "CPU cycles per microsecond"
     help
    The smaller this number is, the more frequent timer interrupts will be.
    If it is too small, you'll be in an interrupt storm.
```

## src/arch/hrt/Kconfig
```kconfig
config HRT_HIHALF_OFFSET
    hex "HRT High-half offset"
    default 0xffff800000000000
    depends on HVM_HRT
    help
      Sets the fixed virtual-to-physical address mapping for the HRT

config HRT_GPA_MAP_REQ
    hex "HRT Max GPA to map"
    default 0x200000000
    depends on HVM_HRT
    help
      Sets the default amount of physical memory that the VMM should
      attempt to map for the HRT

config HRT_COMM_PAGE
    hex "GPA of HRT/HVM communication page"
    default 0x1fffff000
    depends on HVM_HRT
    help
      Sets the default page address at which the VMM and HRT will
      communicate information

config HVM_INT_VEC
    int "HVM/HRT Interrupt vector"
    default 255
    range 33 255
    depends on HVM_HRT
    help
      Sets the interrupt vector to use for communication between
      the VMM and the HRT

choice 
    prompt "HRT Page Size Request"
    depends on HVM_HRT
    default HRT_PS_2M
    help
        Requests a given page size to map the initial page tables 
        from the VMM

    config HRT_PS_512G
      bool "512GB Pages"
      
    config HRT_PS_1G
      bool "1GB Pages"

    config HRT_PS_2M
      bool "2MB Pages"

    config HRT_PS_4K
      bool "4KB Pages"

endchoice
```

## src/arch/riscv/Kconfig
```kconfig
config RISCV_KERNEL_LINK_ADDR
    hex "Kernel Load Address"
    default 0x0
    help
      Sets the base address which the kernel is linked to be loaded at
```

## src/arch/x64/Kconfig
```kconfig
config MAX_IOAPICS
    depends on X86_64_HOST
    int "Maximum Number of IOAPICS"
    range 1 255
    default "16"
    help
      Specifies the maximum number of IOAPICS supported by Nautilus

config APIC_FORCE_XAPIC_MODE
    bool "Force APIC to use XAPIC mode"
    depends on ARCH_X86
    default n
    help
       Force the use of XAPIC mode even if X2APIC mode is available

config APIC_TIMER_CALIBRATE_INDEPENDENTLY
    bool "Calibrate APIC timer independently on each core"
    depends on ARCH_X86
    default n
    help
      If set, each core's APIC timer is independently calibrated
      If not set, only the BSP core's timer is calibrated and
      other cores clone its calibration

config DEBUG_APIC
    bool "Debug APIC"
    depends on ARCH_X86 && DEBUG_PRINTS
    default n
    help
        Turn on debug prints for the LAPIC driver

config DEBUG_IOAPIC
    bool "Debug IOAPIC"
    depends on ARCH_X86 && DEBUG_PRINTS
    default n
    help 
        Turn on debug prints for the IOAPIC driver

config XSAVE_SUPPORT
    bool "Allow saving of FPRs with XSAVE instructions"
    depends on X86_64_HOST
    default y
    help
      Adds xsave instruction support to Nautilus. Processor
      must have xsave support or this feature will be ignored.

config XSAVE_SSE_SUPPORT
    bool "Enable saving of SSE registers with XSAVE"
    default y
    depends on XSAVE_SUPPORT
    help
      Will save SSE state with XSAVE when enabled. Required
      in order to save AVX and AVX512f state. This will
      be ignored if processor does not have SSE registers.

config XSAVE_AVX_SUPPORT
    bool "Enable saving of AVX registers with XSAVE"
    default y
    depends on XSAVE_SUPPORT
    help
      Will save AVX state with XSAVE when enabled. Required
      in order to save AVX512f state. This opt. will
      be ignored if processor does not have AVX registers.

config XSAVE_AVX512F_SUPPORT
    bool "Enable saving of AVX512f registers with XSAVE"
    default y
    depends on XSAVE_SUPPORT
    help
      Will save AVX512f state with XSAVE when enabled. This
      opt will be ignored if processor does not 
      have avx512f registers.
```

## src/aspace/Kconfig
```kconfig
config ASPACES
  bool "Enable Address Spaces"
  default n
  depends on X86_64_HOST
  depends on ALLOW_UNINTEGRATED
  select ASPACE_BASE
  help
     Enable address space abstractions plus address space
     switching on thread context switches
     
config DEBUG_ASPACES
  bool "Debug address space core"
  depends on ASPACES
  default n
  help
     Turn on debugging prints for the address space core
     
config ASPACE_BASE
  bool "Base abstraction"
  depends on ASPACES
  default y
  help
     This is the base address space abstraction
     which is the single, identity-mapped address space
     but now it has a name.   This must always be available

config DEBUG_ASPACE_BASE
  bool "Debug the base address space abstraction"
  depends on ASPACE_BASE
  default n
  help
     Turn on debugging prints for the paging address space abstraction

config ASPACE_PAGING
  bool "Paging abstraction"
  depends on ASPACES
  default y
  help
     This is the paging address space abstraction.
     It does lazy build of identity-mapped page tables, plus
     it allows creation of non-identity-mapped addresses

	  choice
      	  	depends on ASPACE_PAGING
          	prompt "Paging region data structure"
          	default ASPACE_PAGING_REGION_RB_TREE

          	config ASPACE_PAGING_REGION_RB_TREE
           	  bool "Red Black Tree"

          	config ASPACE_PAGING_REGION_SPLAY_TREE
              	  bool "Splay Tree"

          	config ASPACE_PAGING_REGION_LINKED_LIST
              	  bool "Linked List"

                config ASPACE_PAGING_REGION_SKIP_LIST
                  bool "Skip List"
          endchoice


config ASPACE_PAGING_1GB
     bool "Huge Page 1GB"
     depends on ASPACE_PAGING
     default y
     help
       Enable 1GB Huge Page for region aligned with 1GB and length as multiple of 1GB

config ASPACE_PAGING_2MB
  bool "Large Page 2MB"
  depends on ASPACE_PAGING
  default y
  help
    Enable 2MB Large Page for region aligned with 2MB and length as multiple of 2MB

config ASPACE_PAGING_REGION_STRUCT_TEST
  bool "Test region tracking data structures"
  depends on ASPACE_PAGING
  default n
  help
   Test red black tree, splay tree, and linked list against each other

config ASPACE_PAGING_PCID
 bool "PCID for Paging"
 depends on ASPACE_PAGING
 default y
 help
 Enable PCID support for paging address aspace

choice
  depends on ASPACE_PAGING_PCID
    prompt "PCID implementation"
    default ASPACE_PAGING_PCID_QUEUE

    config ASPACE_PAGING_PCID_QUEUE
        bool "Queue"
    config ASPACE_PAGING_PCID_BITMAP
        bool "Bitmap"
endchoice


config DEBUG_ASPACE_PAGING
  bool "Debug the paging address space abstraction"
  depends on ASPACE_PAGING
  default n
  help
     Turn on debugging prints for the paging address space abstraction

config ASPACE_CARAT
  bool "CARAT  abstraction"
  depends on ASPACES
  default y
  help
     This is the CARAT address space abstraction.
     
config DEBUG_ASPACE_CARAT
  bool "Debug the CARAT address space abstraction"
  depends on ASPACE_CARAT
  default n
  help
     Turn on debugging prints for the CARAT address space abstraction

choice
  depends on ASPACE_CARAT
  prompt "CARAT Region data structure"
  default ASPACE_CARAT_REGION_RB_TREE
  
  config ASPACE_CARAT_REGION_RB_TREE
     bool "Red Black Tree"
  
  config ASPACE_CARAT_REGION_SPLAY_TREE
     bool "Splay Tree"
  
  config ASPACE_CARAT_REGION_LINKED_LIST
     bool "Linked List"
  
  config ASPACE_CARAT_REGION_SKIP_LIST
     bool "Skip List"
endchoice

config CARAT_PROFILE
  bool "Enable profiling for CARAT aspace"
  depends on ASPACE_CARAT
  default n
  help
    Turns on profiling for CARAT Aspace

config DEBUG_ASPACE_REGION_TRACKING
  bool "Debug the selected region tracking data structure (RBTree/SplayTree/..)"
    depends on ASPACES
    default y
    help
       Turn on debugging prints for selected region tracking data structure
```

## src/compat/Kconfig
```kconfig
config BASE_LIBC_COMPAT
  bool "Basic libc compatability"
  default y	
  depends on ALLOW_UNINTEGRATED
  help 
    Basic libc compatability layer

config DEBUG_BASE_LIBC_COMPAT
  bool "Debug basic libc compatability"
  depends on BASE_LIBC_COMPAT
  default n	
  help 
    Enable debugging output from the basic libc compatability layer

config BASE_LIBM_COMPAT
  bool "Basic libm compatability"
  default y	
  depends on ALLOW_UNINTEGRATED
  help 
    Basic libm compatability layer

config DEBUG_BASE_LIBM_COMPAT
  bool "Debug basic libm compatability"
  depends on BASE_LIBM_COMPAT
  default n	
  help 
    Enable debugging output from the basic libm compatability layer

config BASE_LINUX_COMPAT
  bool "Basic Linux user-level compatability layer"
  depends on BASE_LIBC_COMPAT
  default y
  help 
    Basic Linux user-level compatability layer

config DEBUG_BASE_LINUX_COMPAT
  bool "Debug basic Linux compatability"
  depends on BASE_LINUX_COMPAT
  default n	
  help 
    Enable debugging output from the basic Linux compatability layer

config BASE_PTHREAD_COMPAT
  bool "POSIX threads compatability layer"
  default y
  depends on BASE_LIBC_COMPAT && BASE_LINUX_COMPAT
  help 
    POSIX threads

config DEBUG_BASE_PTHREAD_COMPAT
  bool "Debug basic POSIX threads compatability layer"
  depends on BASE_PTHREAD_COMPAT
  default n	
  help 
    Enable debugging output from the basic POSIX threads compatability layer
```
